## board/tenkon/tenkon/Kconfig
```kconfig
if TARGET_TENKON

config SYS_CPU
        string
        default "m68k"

config SYS_BOARD
        string
        default "tenkon"

config SYS_VENDOR
        string
        default "tenkon"

config SYS_CONFIG_NAME
        default "tenkon"

config SYS_HAS_SRAM
        default "y"

config SYS_SRAM_BASE
        default "0x00000000"

config SYS_SRAM_SIZE
        default "0x00080000"

endif
```

## configs/tenkon_defconfig
```kconfig
CONFIG_M68K=y
CONFIG_TEXT_BASE=0xFFF08000
CONFIG_NR_DRAM_BANKS=2
CONFIG_DEFAULT_DEVICE_TREE="tenkon"
CONFIG_MULTI_DTB_FIT_UNCOMPRESS_SZ=0x10000
CONFIG_DEBUG_UART_BASE=0xFE400000
CONFIG_DEBUG_UART_CLOCK=3686400
CONFIG_DEBUG_UART_BOARD_INIT=y
CONFIG_SYS_LOAD_ADDR=0x04000000
CONFIG_TARGET_TENKON=y
# CONFIG_MCFTMR is not set
CONFIG_DEBUG_UART=y
CONFIG_SYS_MEMTEST_START=0x04000000
CONFIG_SYS_MEMTEST_END=0x07800000
CONFIG_ENV_VARS_UBOOT_CONFIG=y
# CONFIG_SYS_MALLOC_CLEAR_ON_INIT is not set
CONFIG_STACK_SIZE=0x00100000
CONFIG_FIT=y
# CONFIG_LEGACY_IMAGE_FORMAT is not set
# CONFIG_AUTOBOOT is not set
CONFIG_LOGLEVEL=7
CONFIG_LOG=y
CONFIG_LOG_MAX_LEVEL=9
CONFIG_LOG_DEFAULT_LEVEL=7
CONFIG_CMD_ENV_CALLBACK=y
CONFIG_CMD_MD5SUM=y
CONFIG_CMD_MEMTEST=y
CONFIG_CMD_DM=y
CONFIG_CMD_IO=y
CONFIG_CMD_DHCP=y
CONFIG_SYS_DISABLE_AUTOLOAD=y
CONFIG_CMD_PING=y
CONFIG_CMD_RTC=y
CONFIG_CMD_TIME=y
CONFIG_CMD_GETTIME=y
CONFIG_CMD_TIMER=y
CONFIG_CMD_TERMINAL=y
CONFIG_CMD_DIAG=y
CONFIG_CMD_IRQ=y
CONFIG_OF_CONTROL=y
CONFIG_OF_EMBED=y
# CONFIG_OF_TAG_MIGRATE is not set
CONFIG_NET_RANDOM_ETHADDR=y
CONFIG_BOOTP_SERVERIP=y
CONFIG_USE_SERVERIP=y
CONFIG_SERVERIP="192.168.1.125"
CONFIG_SYS_RX_ETH_BUFFER=64
CONFIG_DM_WARN=y
CONFIG_DM_DEBUG=y
CONFIG_DM_STATS=y
# CONFIG_I2C is not set
CONFIG_NE2000=y
# CONFIG_POWER is not set
CONFIG_DM_RTC=y
CONFIG_DM_SERIAL=y
CONFIG_DEBUG_UART_ANNOUNCE=y
CONFIG_PANIC_HANG=y
# CONFIG_REGEX is not set
# CONFIG_SHA256 is not set
CONFIG_HEXDUMP=y
CONFIG_POST=y
```
